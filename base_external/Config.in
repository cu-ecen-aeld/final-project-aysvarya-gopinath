## base_external/package/aesdchardev/Config.in
```kconfig
config BR2_PACKAGE_AESDCHARDEV
	bool "aesdchardev"
	help
	  Includes AESD character device in the kernel image.
	  Used to understand buildroot external trees and package builds.
	  
	  
	  
	
	  
	  
```

## base_external/package/ldd/config.in
```kconfig
config BR2_PACKAGE_LDD
	bool "ldd"
	help
	  Includes ldd misc modules and scull components in the kernel image.
	  Used to understand buildroot external trees and package builds.
	  
	  
```

## base_external/package/system-monitoring/Config.in
```kconfig
config BR2_PACKAGE_SYSTEM_MONITORING
	bool "system monitoring"
	help
	  Includes the writer executable, tcp server and client in the kernel image.
	 
```
